## conf/layer.conf
```bitbake
# We have a conf and classes directory, append to BBPATH
BBPATH .= ":${LAYERDIR}"

# We have a recipes directory, add to BBFILES
BBFILES += "${LAYERDIR}/recipes*/*/*.bb ${LAYERDIR}/recipes*/*/*.bbappend"

#install gnome (recipe at ${LAYERDIR}/recipes-gnome/gnome/gnome.bb)
IMAGE_PREINSTALL += "gnome"

#add new user for gnome to log into
IMAGE_PREINSTALL += "user"
```
